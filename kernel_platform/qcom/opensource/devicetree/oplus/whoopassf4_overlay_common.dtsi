#include "tp/whoopass-f4-25231-tp.dtsi"
#include "sensor/whoopasss35g-sensor-25231.dtsi"
#include "oplus_uff/oplus_uff_25231.dtsi"

&soc {
    /* Add for low_mem_optimize */
    oplus_mm_config: oplus,mm_config {
        compatible = "oplus,mm_osvelte-config";
        ram-8g {
            oplus_boost_pool {
                feature-disable;
            };
        };
    };
};
