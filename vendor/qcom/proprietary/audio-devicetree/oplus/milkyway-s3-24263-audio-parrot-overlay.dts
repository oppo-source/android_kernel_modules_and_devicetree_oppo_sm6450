/dts-v1/;
/plugin/;
#include <dt-bindings/oplus/hw-id.h>
#include "../parrot-audio-qrd.dts"
#include "parrot_audio_overlay_common.dtsi"
#include "milkyway-s3_24263_audio_overlay_common.dtsi"
/ {
   model = "Qualcomm Technologies, Inc. Parrot QRD, Milkyway-S3";

   oplus,project-id = <24263 24264 24265>;
};
