/dts-v1/;
/plugin/;
#include <dt-bindings/oplus/hw-id.h>
#include "../parrot-audio-qrd.dts"
#include "parrot_audio_overlay_common.dtsi"
#include "whoopass-f4_25231_audio_overlay_common.dtsi"
/ {
    model = "Qualcomm Technologies, Inc. Parrot QRD, Whoopass-F4";

    oplus,project-id = <25231 25232 25233 25234>;
};
