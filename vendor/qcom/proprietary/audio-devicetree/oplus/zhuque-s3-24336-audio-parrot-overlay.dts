/dts-v1/;
/plugin/;
#include <dt-bindings/oplus/hw-id.h>
#include "../parrot-audio-qrd.dts"
#include "parrot_audio_overlay_common.dtsi"
#include "zhuque-s3_24336_audio_overlay_common.dtsi"
/ {
    model = "Qualcomm Technologies, Inc. Parrot QRD, ZhuQue-S3";

    oplus,project-id = <24336 24335 24337>;
};
